## Documentation/devicetree/bindings/iio/adc/microchip,atfcd52-frame-data.yaml
```yaml
# SPDX-License-Identifier: (GPL-2.0-only OR BSD-2-Clause)
%YAML 1.2
---
$id: http://devicetree.org/schemas/iio/adc/microchip,atfcd52-frame-data.yaml#
$schema: http://devicetree.org/meta-schemas/core.yaml#

title: Microchip ATFCD52 SPI frame data interface

maintainers:
  - Michael Gong <michael.gong@microchip.com>

description: |
  The Microchip ATFCD52 fast capacitive digitizer streams measurement frames
  to the system host over a dedicated SPI interface. The digitizer drives
  this interface as the SPI host: it asserts SS, generates SCK and shifts
  data out on MOSI. There is no MISO line, so the flow of data is
  unidirectional, and there is no interrupt line.

  This node therefore does not describe an SPI peripheral. It describes the
  SoC SPI block that receives the stream, which is placed in client mode and
  drained by a cyclic DMA transfer. The block is owned exclusively by this
  driver and must not also be described with a generic SPI controller
  compatible, since both drivers would program the same registers.

  The frame format carries no addressing, so the sensor geometry and frame
  format are not given here. The driver reads them from the Fast Capacitive
  Digitizer T700 object of the digitizer, through the control node referenced
  by microchip,control, described in
  Documentation/devicetree/bindings/iio/adc/microchip,atfcd52.yaml. The
  control node must be bound before this driver can probe; until it is, the
  probe is deferred.

properties:
  compatible:
    const: microchip,atfcd52-frame-data

  reg:
    description: SPI block registers.
    maxItems: 1

  clocks:
    description: Peripheral bus clock for the SPI block.
    maxItems: 1

  dmas:
    description: RX DMA channel draining the SPI receive register.
    maxItems: 1

  dma-names:
    const: rx

  microchip,control:
    $ref: /schemas/types.yaml#/definitions/phandle
    description:
      The digitizer's I2C control node (compatible microchip,atfcd52). The
      frame layout (matrix size, data type and CRC) is read from its T700
      object.

required:
  - compatible
  - reg
  - clocks
  - dmas
  - dma-names
  - microchip,control

additionalProperties: false

examples:
  - |
    #include <dt-bindings/clock/at91.h>
    #include <dt-bindings/dma/at91.h>

    i2c {
        #address-cells = <1>;
        #size-cells = <0>;

        atfcd52: digitizer@4b {
            compatible = "microchip,atfcd52";
            reg = <0x4b>;
            vdd-supply = <&reg_3v3>;
            avdd-supply = <&reg_3v3>;
            microchip,cfg-name = "fcd52.cfg";
        };
    };

    flexcom@e2018000 {
        #address-cells = <1>;
        #size-cells = <1>;
        ranges = <0x0 0xe2018000 0x800>;

        atfcd52-frame-data@400 {
            compatible = "microchip,atfcd52-frame-data";
            reg = <0x400 0x200>;
            clocks = <&pmc PMC_TYPE_PERIPHERAL 38>;
            dmas = <&dma0 AT91_XDMAC_DT_PERID(13)>;
            dma-names = "rx";
            microchip,control = <&atfcd52>;
        };
    };
...
```

## Documentation/devicetree/bindings/iio/adc/microchip,atfcd52.yaml
```yaml
# SPDX-License-Identifier: (GPL-2.0-only OR BSD-2-Clause)
%YAML 1.2
---
$id: http://devicetree.org/schemas/iio/adc/microchip,atfcd52.yaml#
$schema: http://devicetree.org/meta-schemas/core.yaml#

title: Microchip ATFCD52 Fast Capacitive Digitizer (I2C control interface)

maintainers:
  - Michael Gong <michael.gong@microchip.com>

description: |
  The Microchip ATFCD52 is a fast capacitive digitizer that measures node
  capacitance on a sensor matrix. It presents two independent interfaces to
  the system host:

  This node describes the I2C control interface, which carries the
  Object-Based Protocol (OBP) and is used to configure the device and read
  its status.

  Sample data is not carried over I2C. The device streams measurement frames
  over a separate SPI frame data interface, described by its own node, see
  Documentation/devicetree/bindings/iio/adc/microchip,atfcd52-frame-data.yaml

properties:
  compatible:
    const: microchip,atfcd52

  reg:
    description:
      I2C address, selected by the ADDSEL0 and ADDSEL1 pins.
    maxItems: 1

  interrupts:
    description:
      CHG line, asserted low when an OBP message is pending.
    maxItems: 1

  reset-gpios:
    maxItems: 1
    description:
      Reset pin, active low. The line must be flagged with GPIO_ACTIVE_LOW.

  microchip,cfg-name:
    $ref: /schemas/types.yaml#/definitions/string
    description:
      Configuration file for request_firmware(), loaded by update_cfg. The
      default is fcd52.cfg. A subdirectory relative to the firmware search
      paths may be included.

  vdd-supply:
    description: Digital supply, 1.71V to 3.47V.

  avdd-supply:
    description: Analog supply, 2.57V to 3.47V.

required:
  - compatible
  - reg
  - vdd-supply
  - avdd-supply

additionalProperties: false

examples:
  - |
    #include <dt-bindings/gpio/gpio.h>
    #include <dt-bindings/interrupt-controller/irq.h>

    i2c {
        #address-cells = <1>;
        #size-cells = <0>;

        digitizer@4a {
            compatible = "microchip,atfcd52";
            reg = <0x4a>;
            interrupt-parent = <&gpio>;
            interrupts = <23 IRQ_TYPE_LEVEL_LOW>;
            reset-gpios = <&gpio 24 GPIO_ACTIVE_LOW>;
            vdd-supply = <&reg_3v3>;
            avdd-supply = <&reg_3v3>;
            microchip,cfg-name = "fcd52.cfg";
        };
    };
...
```

## fcd52/Kconfig
```kconfig
# SPDX-License-Identifier: GPL-2.0-only
#
# Microchip ATFCD52 Fast Capacitive Digitizer
#

config FCD52
	tristate

config FCD52_I2C
	tristate "Microchip ATFCD52 Fast Capacitive Digitizer (I2C control)"
	depends on I2C
	select FCD52
	help
	  Say yes here to build support for the I2C control interface of the
	  Microchip ATFCD52 fast capacitive digitizer. The I2C interface uses
	  the Object-Based Protocol to configure the device; measurement data
	  is delivered over the separate SPI frame data interface.

	  To compile this driver as a module, choose M here: the modules will
	  be called fcd52-core and fcd52-i2c.

config FCD52_FRAME_DATA
	tristate "Microchip ATFCD52 SPI frame data interface"
	depends on OF
	depends on DMADEVICES
	select FCD52
	select IIO_BUFFER
	select IIO_KFIFO_BUF
	help
	  Say yes here to build support for the SPI frame data interface of
	  the Microchip ATFCD52 fast capacitive digitizer.

	  The digitizer drives this interface as the SPI host, so the SoC SPI
	  block is placed in client mode and a cyclic DMA transfer captures
	  the sample frames continuously. The SPI block used for frame data
	  is owned by this driver and must not also be claimed by a generic
	  SPI controller driver.

	  To compile this driver as a module, choose M here: the module will
	  be called fcd52-frame-data.
```
